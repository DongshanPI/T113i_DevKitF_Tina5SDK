## brandy/brandy-2.0/u-boot-2018/configs/sun8iw20p1_auto_t113_i_defconfig
```kconfig
CONFIG_ARM=y
CONFIG_ARM_SMCCC=y
CONFIG_SYS_TEXT_BASE=0x43000000
CONFIG_SUNXI_SECURE_BOOT=y
CONFIG_MACH_SUN8IW20=y
CONFIG_SUNXI_FDT_ADDR=0x41800000
CONFIG_I2C2_ENABLE=y
CONFIG_DEFAULT_DEVICE_TREE="sun8iw20p1-soc-system"
# CONFIG_SYS_MALLOC_CLEAR_ON_INIT is not set
CONFIG_ANDROID_BOOT_IMAGE=y
# CONFIG_PRE_CONSOLE_BUFFER is not set
CONFIG_CONSOLE_MUX=y
CONFIG_RESERVE_FDT_SIZE=0x20000
CONFIG_SUNXI_MALLOC_LEN=0x3600000
CONFIG_SUNXI_MAC=y
CONFIG_SUNXI_USER_KEY=y
CONFIG_SUNXI_EXTERN_SECURE_MM_LAYOUT=y
CONFIG_SUNXI_NECESSARY_REPLACE_FDT=y
CONFIG_SUNXI_HOMLET=y
CONFIG_SUNXI_HDCP_IN_SECURESTORAGE=y
CONFIG_CMD_FASTBOOT=y
CONFIG_CMD_PART=y
CONFIG_CMD_SUNXI_TIMER=y
CONFIG_CMD_SUNXI_SPRITE=y
CONFIG_CMD_SUNXI_BURN=y
CONFIG_CMD_SUNXI_DMA=y
CONFIG_CMD_SUNXI_MEMTEST=y
CONFIG_CMD_SUNXI_BOOTR=y
CONFIG_CMD_SUNXI_BOOTRV=y
CONFIG_SUNXI_REDUNDAND_ENVIRONMENT=y
CONFIG_SUNXI_GPIO_V2=y
CONFIG_SYS_I2C_SUNXI=y
CONFIG_MMC=y
CONFIG_SIMULATE_MULTIPLANE=y
CONFIG_SPI_FLASH=y
CONFIG_SF_DEFAULT_MODE=0x3000
CONFIG_SF_DEFAULT_SPEED=50000000
CONFIG_SPI_SAMP_DL_EN=y
CONFIG_SPI_FLASH_ATMEL=y
CONFIG_SPI_FLASH_EON=y
CONFIG_SPI_FLASH_GIGADEVICE=y
CONFIG_SPI_FLASH_ISSI=y
CONFIG_SPI_FLASH_MACRONIX=y
CONFIG_SPI_FLASH_SPANSION=y
CONFIG_SPI_FLASH_STMICRO=y
CONFIG_SPI_FLASH_SST=y
CONFIG_SPI_FLASH_WINBOND=y
CONFIG_SPI_FLASH_XMC=y
CONFIG_SPI_FLASH_PUYA=y
CONFIG_SPI_FLASH_FM=y
CONFIG_SPI_FLASH_XT=y
CONFIG_SPI=y
CONFIG_SUNXI_SPI=y
CONFIG_BOOT_GUI=y
# CONFIG_CONFIG_LCD_CHECK_SKIP_OPEN is not set
CONFIG_CMD_SUNXI_BMP=y
CONFIG_DISP2_SUNXI=y
CONFIG_LCD_SUPPORT_LT8912B=y
# CONFIG_LCD_SUPPORT_HE0801A068 is not set
# CONFIG_LCD_SUPPORT_WILLIAMLCD is not set
# CONFIG_LCD_SUPPORT_LQ101R1SX03 is not set
# CONFIG_LCD_SUPPORT_INET_DSI_PANEL is not set
# CONFIG_LCD_SUPPORT_CC08021801_310_800X1280 is not set
# CONFIG_LCD_SUPPORT_T050K589 is not set
# CONFIG_LCD_SUPPORT_KD080D24 is not set
# CONFIG_LCD_SUPPORT_FX070_DHM18BOEL2_1024X600 is not set
# CONFIG_LCD_SUPPORT_CC10132007_40A is not set
# CONFIG_LCD_SUPPORT_NT36523_INCELL_1200X1920 is not set
# CONFIG_LCD_SUPPORT_GM7321C is not set
CONFIG_SUNXI_NAND=y
CONFIG_SUNXI_UBIFS=y
CONFIG_SUNXI_COMM_NAND_V1=y
CONFIG_SUNXI_SDMMC=y
CONFIG_SUNXI_USB=y
CONFIG_SUNXI_EFEX=y
CONFIG_SUNXI_BURN=y
CONFIG_BOOT_RISCV=y
CONFIG_LZMA=y
CONFIG_SUNXI_SPRITE=y
CONFIG_SUNXI_SPRITE_CARTOON=y
```
