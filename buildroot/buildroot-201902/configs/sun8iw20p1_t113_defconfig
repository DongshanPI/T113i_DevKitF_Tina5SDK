## buildroot/buildroot-201902/configs/sun8iw20p1_t113_defconfig
```kconfig
BR2_arm=y
BR2_cortex_a7=y
BR2_ARM_EABI=y
BR2_SVN="svn"
BR2_JLEVEL=16
BR2_TOOLCHAIN_EXTERNAL=y
BR2_TARGET_GENERIC_HOSTNAME="kunos"
BR2_TARGET_GENERIC_ISSUE="Welcome to Allwinner KunoOS Platform"
BR2_ROOTFS_DEVICE_CREATION_DYNAMIC_EUDEV=y
BR2_SYSTEM_BIN_SH_BASH=y
BR2_TARGET_GENERIC_GETTY_PORT="ttyS0"
BR2_TARGET_GENERIC_GETTY_BAUDRATE_115200=y
BR2_ROOTFS_POST_BUILD_SCRIPT="$(TOPDIR)/../config/buildroot/post_build.sh"
BR2_PACKAGE_BUSYBOX_SHOW_OTHERS=y
BR2_PACKAGE_OTA_BURNBOOT=y
BR2_PACKAGE_ADBD=y
BR2_PACKAGE_CPU_MONITOR=y
BR2_PACKAGE_MTOP=y
BR2_PACKAGE_WIFIMANAGER=y
BR2_PACKAGE_WIFIMANAGER_LIB=y
BR2_PACKAGE_WIFIMANAGER_DEMO=y
BR2_PACKAGE_BTMANAGER=y
BR2_PACKAGE_BTMG_DEMO=y
BR2_PACKAGE_WIFI_FIRMWARE=y
BR2_PACKAGE_XR829_FIRMWARE=y
BR2_PACKAGE_XR829_USE_40M=y
BR2_PACKAGE_BUSYBOX_INIT_BASE_FILES=y
BR2_PACKAGE_CEDARX=y
BR2_PACKAGE_JPEGDECODE=y
BR2_PACKAGE_TRECORDER=y
BR2_PACKAGE_ENCODERTEST=y
BR2_PACKAGE_TRECORDERDEMO=y
BR2_PACKAGE_JPEGDECODEDEMO=y
BR2_PACKAGE_TPLAYERDEMO=y
BR2_PACKAGE_BACKPLAYDEMO=y
BR2_PACKAGE_TPLAYER=y
BR2_PACKAGE_LV_G2D_TEST=y
BR2_PACKAGE_PQD=y
LUAPI_LAYER_ALLOC_LAY=y
BR2_PACKAGE_AMP_SHELL=y
BR2_PACKAGE_RPMSG=y
BR2_PACKAGE_RPMSG_DEMO=y
BR2_PACKAGE_RPMSG_TEST=y
BR2_PACKAGE_RPBUF=y
BR2_PACKAGE_RPBUF_DEMO=y
BR2_PACKAGE_RPBUF_TEST=y
BR2_PACKAGE_LIBCEDARSE=y
BR2_PACKAGE_CEDARSE_PARM_ADJUST=y
BR2_PACKAGE_CEDARSE_DEMO=y
BR2_PACKAGE_ALSA_UTILS=y
BR2_PACKAGE_ALSA_UTILS_AMIXER=y
BR2_PACKAGE_ALSA_UTILS_APLAY=y
BR2_PACKAGE_BELLAGIO=y
BR2_PACKAGE_BLUEZ_ALSA_HCITOP=y
BR2_PACKAGE_BLUEZ_ALSA_RFCOMM=y
BR2_PACKAGE_FAAD2=y
BR2_PACKAGE_FLAC=y
BR2_PACKAGE_LAME=y
BR2_PACKAGE_MPG123=y
BR2_PACKAGE_MUSEPACK=y
BR2_PACKAGE_WAVPACK=y
BR2_PACKAGE_LIBTOOL=y
BR2_PACKAGE_DOSFSTOOLS=y
BR2_PACKAGE_DOSFSTOOLS_MKFS_FAT=y
BR2_PACKAGE_E2FSPROGS=y
BR2_PACKAGE_EXFAT=y
BR2_PACKAGE_EXFAT_UTILS=y
BR2_PACKAGE_MTD=y
BR2_PACKAGE_NTFS_3G=y
BR2_PACKAGE_NTFS_3G_ENCRYPTED=y
BR2_PACKAGE_NTFS_3G_NTFSPROGS=y
BR2_PACKAGE_DIRECTFB=y
BR2_PACKAGE_FREERDP=y
# BR2_PACKAGE_FREERDP_CLIENT_WL is not set
BR2_PACKAGE_DTV_SCAN_TABLES=y
BR2_PACKAGE_I2C_TOOLS=y
BR2_PACKAGE_LIBUMP=y
BR2_PACKAGE_MEMTESTER=y
BR2_PACKAGE_MINICOM=y
BR2_PACKAGE_UBOOT_TOOLS=y
BR2_PACKAGE_UBOOT_TOOLS_HAVEREDUNDENV=y
BR2_PACKAGE_PYTHON3=y
BR2_PACKAGE_FDK_AAC=y
BR2_PACKAGE_LIBMAD=y
BR2_PACKAGE_LIBSAMPLERATE=y
BR2_PACKAGE_OPUS=y
BR2_PACKAGE_SPEEX=y
BR2_PACKAGE_TAGLIB=y
BR2_PACKAGE_TINYALSA=y
BR2_PACKAGE_TREMOR=y
BR2_PACKAGE_VO_AACENC=y
BR2_PACKAGE_WEBRTC_AUDIO_PROCESSING=y
BR2_PACKAGE_MYSQL=y
BR2_PACKAGE_POSTGRESQL=y
BR2_PACKAGE_LIBCONFIG=y
BR2_PACKAGE_LIBJPEG=y
BR2_PACKAGE_LIBRSVG=y
BR2_PACKAGE_LIBVA=y
BR2_PACKAGE_OPENJPEG=y
BR2_PACKAGE_WAYLAND=y
BR2_PACKAGE_WAYLAND_PROTOCOLS=y
BR2_PACKAGE_WEBP=y
BR2_PACKAGE_LIBINPUT=y
BR2_PACKAGE_LIBUSB=y
BR2_PACKAGE_LIBV4L=y
BR2_PACKAGE_LIBV4L_UTILS=y
BR2_PACKAGE_LIBXKBCOMMON=y
BR2_PACKAGE_LIBASS=y
BR2_PACKAGE_LIBDVDREAD=y
BR2_PACKAGE_LIBMMS=y
BR2_PACKAGE_LIBMPEG2=y
BR2_PACKAGE_LIBOPENH264=y
BR2_PACKAGE_LIBTHEORA=y
BR2_PACKAGE_LIBVPX=y
BR2_PACKAGE_X264=y
BR2_PACKAGE_X265=y
BR2_PACKAGE_LIBCURL=y
BR2_PACKAGE_LIBRSYNC=y
BR2_PACKAGE_LIBSOCKETCAN=y
BR2_PACKAGE_LIBSOUP=y
BR2_PACKAGE_LIBSRTP=y
BR2_PACKAGE_NEON=y
BR2_PACKAGE_RTMPDUMP=y
BR2_PACKAGE_LIBICAL=y
BR2_PACKAGE_LIBUCI=y
BR2_PACKAGE_PCRE_16=y
BR2_PACKAGE_PCRE_32=y
BR2_PACKAGE_PCRE2=y
BR2_PACKAGE_PCRE2_16=y
BR2_PACKAGE_BLUEZ5_UTILS_CLIENT=y
BR2_PACKAGE_BLUEZ5_UTILS_MONITOR=y
BR2_PACKAGE_BLUEZ5_UTILS_TOOLS=y
BR2_PACKAGE_BLUEZ5_UTILS_DEPRECATED=y
# BR2_PACKAGE_BLUEZ5_UTILS_PLUGINS_NETWORK is not set
BR2_PACKAGE_CAN_UTILS=y
BR2_PACKAGE_DNSMASQ=y
BR2_PACKAGE_DNSMASQ_DNSSEC=y
BR2_PACKAGE_DNSMASQ_IDN=y
BR2_PACKAGE_DNSMASQ_CONNTRACK=y
BR2_PACKAGE_HOSTAPD=y
BR2_PACKAGE_HOSTAPD_EAP=y
BR2_PACKAGE_HOSTAPD_WPS=y
BR2_PACKAGE_IPERF=y
BR2_PACKAGE_IPERF3=y
BR2_PACKAGE_IPROUTE2=y
BR2_PACKAGE_IPTABLES=y
BR2_PACKAGE_IPTABLES_BPF_NFSYNPROXY=y
BR2_PACKAGE_IPTABLES_NFTABLES=y
BR2_PACKAGE_IW=y
BR2_PACKAGE_WPA_SUPPLICANT=y
BR2_PACKAGE_WPA_SUPPLICANT_AP_SUPPORT=y
BR2_PACKAGE_WPA_SUPPLICANT_WIFI_DISPLAY=y
BR2_PACKAGE_WPA_SUPPLICANT_MESH_NETWORKING=y
BR2_PACKAGE_WPA_SUPPLICANT_AUTOSCAN=y
BR2_PACKAGE_WPA_SUPPLICANT_EAP=y
BR2_PACKAGE_WPA_SUPPLICANT_HOTSPOT=y
BR2_PACKAGE_WPA_SUPPLICANT_DEBUG_SYSLOG=y
BR2_PACKAGE_WPA_SUPPLICANT_WPS=y
BR2_PACKAGE_WPA_SUPPLICANT_CLI=y
BR2_PACKAGE_ANDROID_TOOLS=y
BR2_PACKAGE_SWUPDATE=y
SWUPDATE_CONFIG_DOWNLOAD=y
BR2_PACKAGE_VIM=y
BR2_TARGET_ROOTFS_EXT2=y
BR2_TARGET_ROOTFS_EXT2_4=y
BR2_TARGET_ROOTFS_EXT2_SIZE="512M"
# BR2_TARGET_ROOTFS_TAR is not set
BR2_PACKAGE_HOST_DOSFSTOOLS=y
BR2_PACKAGE_HOST_DTC=y
BR2_PACKAGE_HOST_GENEXT2FS=y
BR2_PACKAGE_HOST_GENIMAGE=y
BR2_PACKAGE_HOST_MTOOLS=y
```
